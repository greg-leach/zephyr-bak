## boards/ezurio/bl654_dvk/bl654_dvk_xtal32k_qspi_2mb_defconfig
```kconfig
# SPDX-License-Identifier: Apache-2.0

# Enable MPU
CONFIG_ARM_MPU=y

# Enable GPIO
CONFIG_GPIO=y

CONFIG_CLOCK_CONTROL_NRF_K32SRC_XTAL=y
CONFIG_CLOCK_CONTROL_NRF_K32SRC_150PPM=y

CONFIG_NORDIC_QSPI_NOR=y
CONFIG_NORDIC_QSPI_NOR_FLASH_LAYOUT_PAGE_SIZE=4096
CONFIG_NORDIC_QSPI_NOR_STACK_WRITE_BUFFER_SIZE=16
```

## boards/ezurio/bl654_dvk/board.yml
```yaml
board:
  name: bl654_dvk
  vendor: ezurio
  socs:
  - name: nrf52840
    variants:
    - name: pa
    - name: xtal32k_qspi
    - name: xtal32k_qspi_2mb
```

## boards/ezurio/sera_nx040_click/Kconfig.defconfig
```kconfig
# Sera NX040 click board configuration

# Copyright (c) 2024 Ezurio
# SPDX-License-Identifier: Apache-2.0

if BOARD_SERA_NX040_CLICK

config BT_CTLR
	default BT

config HW_STACK_PROTECTION
	default ARCH_HAS_STACK_PROTECTION

endif # BOARD_SERA_NX040_CLICK
```

## boards/ezurio/sera_nx040_click/Kconfig.sera_nx040_click
```kconfig
# Sera NX040 click board configuration

# Copyright (c) 2024 Ezurio
# SPDX-License-Identifier: Apache-2.0

config BOARD_SERA_NX040_CLICK
	select SOC_NRF52833_QIAA
```

## boards/ezurio/sera_nx040_dvk/Kconfig.sera_nx040_dvk
```kconfig
# Sera NX040 DVK board configuration

# Copyright (c) 2023-2024 Ezurio
# SPDX-License-Identifier: Apache-2.0

config BOARD_SERA_NX040_DVK
	select SOC_NRF52833_QIAA
```

## boards/ezurio/sera_nx040_tag/Kconfig.defconfig
```kconfig
# Sera NX040 DVK board configuration

# Copyright (c) 2024 Laird Connectivity
# SPDX-License-Identifier: Apache-2.0

if BOARD_SERA_NX040_TAG

config BT_CTLR
	default BT

config HW_STACK_PROTECTION
	default ARCH_HAS_STACK_PROTECTION

endif # BOARD_SERA_NX040_TAG
```

## boards/ezurio/sera_nx040_tag/Kconfig.sera_nx040_tag
```kconfig
# Sera NX040 tag board configuration

# Copyright (c) 2024 Ezurio
# SPDX-License-Identifier: Apache-2.0

config BOARD_SERA_NX040_TAG
	select SOC_NRF52833_QIAA
```

## boards/ezurio/sera_nx040_tag/sera_nx040_tag_defconfig
```kconfig
# SPDX-License-Identifier: Apache-2.0

# Enable MPU
CONFIG_ARM_MPU=y

# enable GPIO
CONFIG_GPIO=y

# enable uart driver
CONFIG_SERIAL=y

# enable SPI
CONFIG_SPI=y

# SPI flash is included in the module
CONFIG_SPI_NOR=y
CONFIG_SPI_NOR_SFDP_RUNTIME=y
CONFIG_FLASH_JESD216_API=y

# enable console
CONFIG_CONSOLE=y
CONFIG_UART_CONSOLE=y

# 32kHz clock source
CONFIG_CLOCK_CONTROL_NRF_K32SRC_XTAL=y
CONFIG_CLOCK_CONTROL_NRF_K32SRC_150PPM=y

CONFIG_PINCTRL=y
```

## drivers/modem/Kconfig
```kconfig
# Kconfig - Modem configuration options

#
# Copyright (c) 2018 Foundries.io
#
# SPDX-License-Identifier: Apache-2.0
#

menuconfig MODEM
	bool "Modem Drivers"
	help
	  Enable config options for modem drivers.

if MODEM

module = MODEM
module-str = modem
source "subsys/logging/Kconfig.template.log_config"

config MODEM_RECEIVER
	bool "Enable modem receiver helper driver"
	depends on SERIAL_SUPPORT_INTERRUPT
	select UART_INTERRUPT_DRIVEN
	select RING_BUFFER
	help
	  This driver allows modem drivers to communicate over UART with custom
	  defined protocols. Driver doesn't inspect received data and all
	  aspects of received protocol data are handled by application via
	  work method provided.  This driver differs from the pipe UART driver
	  in that callbacks are executed in a different work queue and data is
	  passed around in k_pipe structures.

config MODEM_RECEIVER_MAX_CONTEXTS
	int "Maximum number of modem receiver contexts"
	depends on MODEM_RECEIVER
	range 1 10
	default 1
	help
	  Maximum number of modem receiver contexts to handle.  For most
	  purposes this should stay at 1.

config MODEM_SHELL
	bool "Enable modem shell utilities"
	select SHELL
	help
	  Activate shell module that provides modem utilities like
	  sending a command to the modem UART.

source "drivers/modem/Kconfig.ublox-sara-r4"
source "drivers/modem/Kconfig.wncm14a2a"

config MODEM_HL7800
	bool "Enable Sierra Wireless HL7800 modem driver"
	select MODEM_RECEIVER
	select NET_OFFLOAD
	select GPIO_NRF_P1 if SOC_NRF52840
	select UART_1_NRF_UARTE if SOC_NRF52840
	select UART_1_NRF_FLOW_CONTROL if SOC_NRF52840
	help
	  Choose this setting to enable Sierra Wireless HL7800 LTE-M/NB-IoT modem driver.

config MODEM_HL7800_RX_STACK_SIZE
	int "Size of the stack for the HL7800 modem driver RX thread"
	depends on MODEM_HL7800
	default 1028
	help
	  This stack is used by the HL7800 RX thread.

config MODEM_HL7800_RX_WORKQ_STACK_SIZE
	int "Size of the stack for the HL7800 modem driver work queue"
	depends on MODEM_HL7800
	default 2048
	help
	  This stack is used by the work queue to pass off net_pkt data
	  to the rest of the network stack, letting the rx thread continue
	  processing data.

config MODEM_HL7800_APN_NAME
	string "APN name for establishing network connection"
	depends on MODEM_HL7800
	default "jtm2m"
	help
	  This setting is used in the AT+KCNXCFG command to set the APN name
	  for the network connection context.  Normally, don't need to change
	  this value.

config MODEM_HL7800_INIT_PRIORITY
	int "HL7800 driver init priority"
	depends on MODEM_HL7800
	default 80
	help
	  HL7800 device driver initialization priority.
	  Do not mess with it unless you know what you are doing.
	  Note that the priority needs to be lower than the net stack
	  so that it can start before the networking sub-system.

endif # MODEM
```

## drivers/modem/Kconfig.hl7800
```kconfig
# Kconfig - Sierra Wireless HL7800 driver options

#
# Copyright (c) 2019 Laird Connectivity
#
# SPDX-License-Identifier: Apache-2.0
#

menuconfig MODEM_HL7800
	bool "Enable Sierra Wireless HL7800 modem driver"
	select MODEM_RECEIVER
	select NET_OFFLOAD
	select DEVICE_POWER_MANAGEMENT
	imply GPIO
	help
	  Choose this setting to enable Sierra Wireless HL7800 LTE-M/NB-IoT modem driver.

if MODEM_HL7800

config MODEM_HL7800_APN_NAME
	string "APN name for establishing network connection"
	default ""
	help
	  This setting is used in the AT+KCNXCFG command to set the APN name
	  for the network connection context.

choice
	prompt "Radio Access Technology (RAT)"
	default MODEM_HL7800_CAT_M1

config MODEM_HL7800_CAT_M1
	bool "LTE cat M1"
	help
	  Enable LTE cat M1 (LTE-M1) mode

config MODEM_HL7800_CAT_NB1
	bool "LTE cat NB1"
	help
	  Enable LTE cat NB1 (NB-IoT) mode
endchoice

menuconfig MODEM_HL7800_CONFIGURE_BANDS
	bool "Configure modem bands"
	default "y"
	help
	  Choose this setting to configure which LTE bands the HL7800 modem should use.

if MODEM_HL7800_CONFIGURE_BANDS

config MODEM_HL7800_BAND_1
	bool "Enable Band 1  (2000MHz)"
	default "n"
	help
	  Enable Band 1 (2000MHz)

config MODEM_HL7800_BAND_2
	bool "Enable Band 2  (1900MHz)"
	default "y"
	help
	  Enable Band 2 (1900MHz)

config MODEM_HL7800_BAND_3
	bool "Enable Band 3  (1800MHz)"
	default "n"
	help
	  Enable Band 3 (1800MHz)

config MODEM_HL7800_BAND_4
	bool "Enable Band 4  (1700MHz)"
	default "y"
	help
	  Enable Band 4 (1700MHz)

config MODEM_HL7800_BAND_5
	bool "Enable Band 5  (850MHz)"
	default "y"
	help
	  Enable Band 5 (850MHz)

config MODEM_HL7800_BAND_8
	bool "Enable Band 8  (900MHz)"
	default "n"
	help
	  Enable Band 8 (900MHz)

config MODEM_HL7800_BAND_9
	bool "Enable Band 9  (1900MHz)"
	default "n"
	help
	  Enable Band 9 (1900MHz)

config MODEM_HL7800_BAND_10
	bool "Enable Band 10 (2100MHz)"
	default "n"
	help
	  Enable Band 10 (2100MHz)

config MODEM_HL7800_BAND_12
	bool "Enable Band 12 (700MHz)"
	default "y"
	help
	  Enable Band 12 (700MHz)

config MODEM_HL7800_BAND_13
	bool "Enable Band 13 (700MHz)"
	default "y"
	help
	  Enable Band 13 (700MHz)

config MODEM_HL7800_BAND_14
	bool "Enable Band 14 (700MHz)"
	default "n"
	help
	  Enable Band 14 (700MHz)

config MODEM_HL7800_BAND_17
	bool "Enable Band 17 (700MHz)"
	default "y"
	help
	  Enable Band 17 (700MHz)

config MODEM_HL7800_BAND_18
	bool "Enable Band 18 (800MHz)"
	default "n"
	help
	  Enable Band 18 (800MHz)

config MODEM_HL7800_BAND_19
	bool "Enable Band 19 (800MHz)"
	default "n"
	help
	  Enable Band 19 (800MHz)

config MODEM_HL7800_BAND_20
	bool "Enable Band 20 (800MHz)"
	default "y"
	help
	  Enable Band 20 (800MHz)

config MODEM_HL7800_BAND_25
	bool "Enable Band 25 (1900MHz)"
	default "n"
	help
	  Enable Band 25 (1900MHz)

config MODEM_HL7800_BAND_26
	bool "Enable Band 26 (800MHz)"
	default "n"
	help
	  Enable Band 26 (800MHz)

config MODEM_HL7800_BAND_27
	bool "Enable Band 27 (800MHz)"
	default "n"
	help
	  Enable Band 27 (800MHz)

config MODEM_HL7800_BAND_28
	bool "Enable Band 28 (700MHz)"
	default "n"
	help
	  Enable Band 28 (700MHz)

config MODEM_HL7800_BAND_66
	bool "Enable Band 66 (1800MHz)"
	default "n"
	help
	  Enable Band 66 (1800MHz)

endif # MODEM_HL7800_CONFIGURE_BAND

menuconfig MODEM_HL7800_LOW_POWER_MODE
	bool "Enable low power modes"
	help
		Choose this setting to enable a low power mode for the HL7800 modem

if MODEM_HL7800_LOW_POWER_MODE

choice
	prompt "Low Power Mode"
	default MODEM_HL7800_EDRX

config MODEM_HL7800_EDRX
	bool "eDRX"
	help
	  Enable LTE eDRX

config MODEM_HL7800_PSM
	bool "PSM"
	help
	  Enable Power Save Mode (PSM)
endchoice

if MODEM_HL7800_EDRX

config MODEM_HL7800_EDRX_VALUE
	string "Requested eDRX timer"
	default "0101"
	help
	  Half a byte in a 4-bit format. The eDRX value refers to bit 4 to 1
	  of octet 3 of the Extended DRX parameters information element.

endif # MODEM_HL7800_EDRX

if MODEM_HL7800_PSM

config MODEM_HL7800_PSM_PERIODIC_TAU
	string "Requested extended periodic TAU timer"
	default "10000010"
	help
	  Requested extended periodic TAU (tracking area update) value (T3412)
	  to be allocated to the UE in E-UTRAN. One byte in an 8-bit format.

config MODEM_HL7800_PSM_ACTIVE_TIME
	string "Requested active time"
	default "00001111"
	help
	  Requested Active Time value (T3324) to be allocated to the UE.
	  One byte in an 8-bit format.

endif # MODEM_HL7800_PSM

endif # MODEM_HL7800_LOW_POWER_MODE

config MODEM_HL7800_RX_STACK_SIZE
	int "Size of the stack for the HL7800 modem driver RX thread"
	default 1024
	help
	  This stack is used by the HL7800 RX thread.

config MODEM_HL7800_RX_WORKQ_STACK_SIZE
	int "Size of the stack for the HL7800 modem driver work queue"
	default 2048
	help
	  This stack is used by the work queue to pass off net_pkt data
	  to the rest of the network stack, letting the rx thread continue
	  processing data.

config MODEM_HL7800_INIT_PRIORITY
	int "HL7800 driver init priority"
	default 80
	help
	  HL7800 device driver initialization priority.
	  Do not mess with it unless you know what you are doing.
	  Note that the priority needs to be lower than the net stack
	  so that it can start before the networking sub-system.

endif # MODEM_HL7800
```

## drivers/spi/Kconfig.mcux_ecspi
```kconfig
# MCUXpresso SDK SPI

# Copyright (c) 2022, Laird Connectivity
# SPDX-License-Identifier: Apache-2.0

config SPI_MCUX_ECSPI
	bool "MCUX ECSPI driver"
	depends on HAS_MCUX_ECSPI && CLOCK_CONTROL
	help
	  Enable support for mcux enhanced configurable SPI driver.
```

## dts/bindings/can/nxp,imx8mp-mcux-flexcan.yaml
```yaml
# Copyright (c) 2022, Laird Connectivity
# SPDX-License-Identifier: Apache-2.0

description: NXP MCUX FlexCAN controller (i.MX 8M Plus SoC)

compatible: "nxp,imx8mp-mcux-flexcan"

include: nxp,kinetis-flexcan.yaml

properties:
    clock-rootmux:
      type: int
      required: false
      default: 4
      enum:
        - 0 # Clock from OSC 24M
        - 1 # Clock from SYSTEM PLL2 divided by 5
        - 2 # Clock from SYSTEM PLL1 divided by 20
        - 3 # Clock from SYSTEM PLL1 divided by 5
        - 4 # Clock from SYSTEM PLL1
        - 5 # Clock from SYSTEM PLL3
        - 6 # Clock from SYSTEM PLL2 divided by 4
        - 7 # Clock from AUDIO PLL2

    clock-root-pre-divider:
      type: int
      required: false
      default: 2

    clock-root-post-divider:
      type: int
      required: false
      default: 5
```

## dts/bindings/i2c/nxp,mcux-ii2c.yaml
```yaml
# Copyright (c) 2022, Laird Connectivity
# SPDX-License-Identifier: Apache-2.0

description: NXP i.MX MCUX II2C controller

compatible: "nxp,mcux-ii2c"

include: i2c-controller.yaml

properties:
    reg:
      required: true

    interrupts:
      required: true

    bus-idle-timeout:
      required: false
      type: int
      description: Bus idle timeout in nanoseconds

    clock-rootmux:
      type: int
      required: false
      default: 1
      enum:
        - 0 # Clock from OSC 24M
        - 1 # Clock from SYSTEM PLL1 divided by 5
        - 2 # Clock from SYSTEM PLL2 divided by 20
        - 3 # Clock from SYSTEM PLL3
        - 4 # Clock from AUDIO PLL1
        - 5 # Clock from VIDEO PLL1
        - 6 # Clock from AUDIO PLL2
        - 7 # Clock from SYSTEM PLL1 divided by 6

    clock-root-pre-divider:
      type: int
      required: false
      default: 1

    clock-root-post-divider:
      type: int
      required: false
      default: 10
```

## dts/bindings/modem/swi,hl7800.yaml
```yaml
#
# Copyright (c) 2019, Laird Connectivity
#
# SPDX-License-Identifier: Apache-2.0
#
---
title: Sierra Wireless HL7800 LTE-M/NB-IoT Modem
version: 0.1

description: >
    This is a representation of the Sierra Wireless HL7800 LTE-M/NB-IoT modem.

inherits:
    !include uart-device.yaml

properties:
    compatible:
      type: string
      category: required
      constraint: "swi,hl7800"
      generation: define

    mdm-wake-gpios:
      type: compound
      category: required
      generation: define, use-prop-name

    mdm-reset-gpios:
      type: compound
      category: required
      generation: define, use-prop-name

    mdm-pwr-on-gpios:
      type: compound
      category: required
      generation: define, use-prop-name

    mdm-fast-shutd-gpios:
      type: compound
      category: required
      generation: define, use-prop-name

    mdm-uart-dtr-gpios:
      type: compound
      category: required
      generation: define, use-prop-name

    mdm-vgpio-gpios:
      type: compound
      category: required
      generation: define, use-prop-name

    mdm-uart-dsr-gpios:
      type: compound
      category: required
      generation: define, use-prop-name

    mdm-uart-tx-gpios:
      type: compound
      category: required
      generation: define, use-prop-name

    mdm-uart-rts-gpios:
      type: compound
      category: required
      generation: define, use-prop-name

    mdm-uart-rx-gpios:
      type: compound
      category: required
      generation: define, use-prop-name

    mdm-uart-cts-gpios:
      type: compound
      category: required
      generation: define, use-prop-name
...
```

## dts/bindings/pwm/fsl,imx8mp-pwm.yaml
```yaml
# Copyright (c) 2022, Laird Connectivity
# SPDX-License-Identifier: Apache-2.0

description: |
    NXP MCUX PWM controller (i.MX 8M Plus SoC), based on the fsl,imx7d-pwm
    driver

compatible: "fsl,imx8mp-pwm"

include: fsl,imx7d-pwm.yaml

properties:
    clock-rootmux:
      type: int
      required: false
      default: 0
      enum:
        - 0 # Clock from OSC 24M
        - 1 # Clock from SYSTEM PLL2 divided by 10
        - 2 # Clock from SYSTEM PLL1 divided by 5
        - 3 # Clock from SYSTEM PLL1 divided by 20
        - 4 # Clock from SYSTEM PLL3
        - 5 # Clock from External Clock 1, External Clock 2
        - 6 # Clock from SYSTEM PLL1 divided by 10
        - 7 # Clock from VIDEO PLL1

    clock-root-pre-divider:
      type: int
      required: false
      default: 1

    clock-root-post-divider:
      type: int
      required: false
      default: 1
```
