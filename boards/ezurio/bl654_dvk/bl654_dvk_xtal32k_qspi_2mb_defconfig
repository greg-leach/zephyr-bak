## dts/bindings/serial/nxp,imx8mp-iuart.yaml
```yaml
# Copyright (c) 2022, Laird Connectivity
# SPDX-License-Identifier: Apache-2.0

description: |
    This binding gives a base representation of the NXP iMX IUART (i.MX 8M Plus
    SoC)

compatible: "nxp,imx8mp-iuart"

include: nxp,imx-iuart.yaml

properties:
    clock-rootmux:
      type: int
      required: false
      default: 1
      enum:
        - 0 # Clock from OSC 24M
        - 1 # Clock from SYSTEM PLL1 divided by 10
        - 2 # Clock from SYSTEM PLL2 divided by 5
        - 3 # Clock from SYSTEM PLL2 divided by 10
        - 4 # Clock from SYSTEM PLL3
        - 5 # Clock from External Clock 2
        - 6 # Clock from External Clock 3, External Clock 4
        - 7 # Clock from AUDIO PLL2

    clock-root-pre-divider:
      type: int
      required: false
      default: 1

    clock-root-post-divider:
      type: int
      required: false
      default: 1
```

## dts/bindings/spi/nxp,imx8mp-flexspi.yaml
```yaml
# Copyright (c) 2022, Laird Connectivity
# SPDX-License-Identifier: Apache-2.0

description: NXP FlexSPI controller (i.MX 8M Plus SoC)

compatible: "nxp,imx8mp-flexspi"

include: nxp,imx-flexspi.yaml

properties:
    clock-rootmux:
      type: int
      required: false
      default: 0
      enum:
        - 0 # Clock from OSC 24M
        - 1 # Clock from SYSTEM PLL1 divided by 2
        - 2 # Clock from SYSTEM PLL2 divided by 3
        - 3 # Clock from SYSTEM PLL2 divided by 2
        - 4 # Clock from AUDIO PLL2
        - 5 # Clock from SYSTEM PLL1 divided by 3
        - 6 # Clock from SYSTEM PLL3
        - 7 # Clock from SYSTEM PLL1 divided by 8

    clock-root-pre-divider:
      type: int
      required: false
      default: 1

    clock-root-post-divider:
      type: int
      required: false
      default: 1
```

## dts/bindings/spi/nxp,mcux-ecspi.yaml
```yaml
# Copyright (c) 2022, Laird Connectivity
# SPDX-License-Identifier: Apache-2.0

description: NXP MCUX ECSPI controller

compatible: "nxp,mcux-ecspi"

include: spi-controller.yaml

properties:
    reg:
      required: true

    interrupts:
      required: true

    clocks:
      required: true

    chip-select-delay:
      type: int
      required: false
      default: 0
      description: |
        This field defines how many SPI clocks will be inserted between the
        chip select's active edge and the first SPI clock edge. The range is
        from 0 to 63.

    sample-period:
      type: int
      required: false
      default: 0
      description: |
        This field controls the number of wait states to be inserted in data
        transfers. The range is 0 to 32767.

    sample-period-clock-source:
      type: int
      required: false
      default: 0
      description: |
        This field selects the clock source for the sample period counter.
      enum:
        - 0 # SPI clock (SCLK)
        - 1 # Low-frequency reference clock (32.768 kHz)

    burst-length:
      type: int
      required: false
      default: 8
      description: |
        This field defines the length of a SPI burst to be transferred. The Chip
        Select (SS) will remain asserted until all bits in a SPI burst are
        shifted out. A maximum of 2^12 bits can be transferred in a single SPI
        burst.

    clock-inactive-state:
      type: int
      required: false
      default: 0
      description: |
        This field controls the inactive state of SCLK.
      enum:
        - 0 # Stay low
        - 1 # Stay high

    data-line-inactive-state:
      type: int
      required: false
      default: 1
      description: |
        This field controls the inactive state of the data line (MISO & MOSI).
      enum:
        - 0 # Stay high
        - 1 # Stay low

    chip-select-active-state:
      type: int
      required: false
      default: 0
      description: |
        This field selects the polarity of the Chip Select (SS) signal.
      enum:
        - 0 # Active low
        - 1 # Active high
```

## dts/bindings/timer/nxp,imx8mp-gpt.yaml
```yaml
# Copyright (c) 2022, Laird Connectivity
# SPDX-License-Identifier: Apache-2.0

description: NXP MCUX General-Purpose Timer (GPT) (i.MX 8M Plus SoC)

compatible: "nxp,imx8mp-gpt"

include: nxp,imx-gpt.yaml

properties:
    clock-rootmux:
      type: int
      required: false
      default: 0
      enum:
        - 0 # Clock from OSC 24M
        - 1 # Clock from SYSTEM PLL2 divided by 10
        - 2 # Clock from SYSTEM PLL1 divided by 2
        - 3 # Clock from SYSTEM PLL1 divided by 20
        - 4 # Clock from VIDEO PLL1
        - 5 # Clock from SYSTEM PLL1 divided by 10
        - 6 # Clock from AUDIO PLL1
        - 7 # Clock from External Clock 1, External Clock 2, External Clock 3

    clock-root-pre-divider:
      type: int
      required: false
      default: 1

    clock-root-post-divider:
      type: int
      required: false
      default: 1
```

## dts/bindings/watchdog/nxp,imx8mp-wdog.yaml
```yaml
# Copyright (c) 2022, Laird Connectivity
# SPDX-License-Identifier: Apache-2.0

description: NXP MCUX Watchdog (i.MX 8M Plus SoC)

compatible: "nxp,imx8mp-wdog"

include: nxp,imx-wdog.yaml

properties:
    clock-rootmux:
      type: int
      required: false
      default: 0
      enum:
        - 0 # Clock from OSC 24M
        - 1 # Clock from SYSTEM PLL1 divided by 6
        - 2 # Clock from SYSTEM PLL1 divided by 5
        - 3 # Clock from VPU PLL
        - 4 # Clock from SYSTEM PLL2 divided by 8
        - 5 # Clock from SYSTEM PLL3
        - 6 # Clock from SYSTEM PLL1 divided by 10
        - 7 # Clock from SYSTEM PLL2 divided by 6

    clock-root-pre-divider:
      type: int
      required: false
      default: 1

    clock-root-post-divider:
      type: int
      required: false
      default: 1
```

## soc/arm/lairdconnectivity/Kconfig
```kconfig
# Copyright (c) 2022, Laird Connectivity
# SPDX-License-Identifier: Apache-2.0

config SOC_FAMILY_SOM8M
	bool
	select HAS_SEGGER_RTT

if SOC_FAMILY_SOM8M

config SOC_FAMILY
	string
	default "lairdconnectivity"

source "soc/arm/lairdconnectivity/*/Kconfig.soc"

config SOC_PART_NUMBER
	default SOC_PART_NUMBER_IMX8ML_M7 if SOC_SERIES_SUMMIT_SOM8M

endif # SOC_FAMILY_SOM8M
```
