/*
 * Copyright (c) 2022, Laird Connectivity
 *
 * SPDX-License-Identifier: Apache-2.0
 */

#include <nxp/nxp_imx8ml_m7.dtsi>

/ {
	chosen {
		zephyr,console = &uart4;
		zephyr,shell-uart = &uart4;
	};
};
