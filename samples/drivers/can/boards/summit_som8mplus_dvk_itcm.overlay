/*
 * Copyright (c) 2022, Laird Connectivity
 *
 * SPDX-License-Identifier: Apache-2.0
 */

&i2c3 {
	status ="okay";
	clock-rootmux = <0>;
	clock-root-pre-divider = <1>;
	clock-root-post-divider = <1>;
};

&flexcan1 {
	status = "okay";
	clock-rootmux = <0>;
	clock-root-pre-divider = <1>;
	clock-root-post-divider = <1>;
};

&gpio3 {
	status = "okay";
};
