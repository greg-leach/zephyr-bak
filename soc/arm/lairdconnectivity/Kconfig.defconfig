## soc/arm/lairdconnectivity/Kconfig.defconfig
```kconfig
# Copyright (c) 2022, Laird Connectivity
# SPDX-License-Identifier: Apache-2.0

if SOC_FAMILY_SOM8M

config SERIAL_INIT_PRIORITY
	default 55
	depends on SERIAL

source "soc/arm/lairdconnectivity/*/Kconfig.defconfig.series"

endif # SOC_FAMILY_SOM8M
```

## soc/arm/lairdconnectivity/Kconfig.soc
```kconfig
# Copyright (c) 2022, Laird Connectivity
# SPDX-License-Identifier: Apache-2.0

source "soc/arm/lairdconnectivity/*/Kconfig.series"
```

## soc/arm/lairdconnectivity/summit_som8m/Kconfig.defconfig.series
```kconfig
# Summit SOM 8M series defconfig

# Copyright (c) 2022, Laird Connectivity
# SPDX-License-Identifier: Apache-2.0

if SOC_SERIES_SUMMIT_SOM8M

config SOC_SERIES
	default "summit_som8m"

config NUM_IRQS
	int
	# must be >= the highest interrupt number used
	default 159

if COUNTER

config COUNTER_MCUX_GPT
	default y if HAS_MCUX_GPT

endif # COUNTER

config CAN_MCUX_FLEXCAN
	default y if HAS_MCUX_FLEXCAN
	depends on CAN

config GPIO_MCUX_IGPIO
	default y if HAS_MCUX_IGPIO
	depends on GPIO

config PWM_IMX
	default y
	depends on PWM

config AUDIOMIX
	bool "Enable AUDIOMIX"
	default n
	depends on HAS_MCUX_AUDIOMIX
	select SYSTEM_PLL1

config WDT_MCUX_IMX_WDOG
	default y
	depends on WATCHDOG

config PM_MCUX_GPC
	default y if HAS_MCUX_GPC
	depends on PM

config SPI_MCUX_ECSPI
	default y if HAS_MCUX_ECSPI
	depends on SPI

source "soc/arm/lairdconnectivity/summit_som8m/Kconfig.defconfig.summit_som8mplus"

endif # SOC_SERIES_SUMMIT_SOM8M
```

## soc/arm/lairdconnectivity/summit_som8m/Kconfig.defconfig.summit_som8mplus
```kconfig
# Summit SOM 8M Plus SoC defconfig

# Copyright (c) 2022, Laird Connectivity
# SPDX-License-Identifier: Apache-2.0

if SOC_SUMMIT_SOM8MPLUS

config SOC
	string
	default "summit_som8mplus"

# set the tick per sec as a divider of the GPT clock source
config SYS_CLOCK_TICKS_PER_SEC
	default 4096 if MCUX_GPT_TIMER

config SYS_CLOCK_HW_CYCLES_PER_SEC
	int
	default 32768 if MCUX_GPT_TIMER
	default 24000000 if M7_CLOCK_ROOT_24M_OSC
	default 200000000 if M7_CLOCK_ROOT_SYSTEM_PLL2_DIV5
	default 250000000 if M7_CLOCK_ROOT_SYSTEM_PLL2_DIV4
	default 800000000 if M7_CLOCK_ROOT_VPU_PLL
	default 800000000 if M7_CLOCK_ROOT_SYSTEM_PLL1
	default 650000000 if M7_CLOCK_ROOT_AUDIO_PLL1
	default 1190000000 if M7_CLOCK_ROOT_VIDEO_PLL1
	default 1000000000 if M7_CLOCK_ROOT_SYSTEM_PLL3

if CLOCK_CONTROL

config CLOCK_CONTROL_MCUX_CCM
	default y if HAS_MCUX_CCM

endif # CLOCK_CONTROL

config I2C_MCUX_II2C
	default y
	depends on I2C

if PINMUX

config PINMUX_MCUX
	default y

endif # PINMUX

config GPIO
	default y

if SERIAL

config UART_MCUX_IUART
	default y

endif # SERIAL

config IPM_IMX_REV2
	default y
	depends on IPM

if CODE_ITCM

config FLASH_SIZE
	default $(dt_node_reg_size_int,/soc/itcm@0,0,K)

config FLASH_BASE_ADDRESS
	default $(dt_node_reg_addr_hex,/soc/itcm@0)

endif # CODE_ITCM

if CODE_DDR

config FLASH_SIZE
	default $(dt_node_reg_size_int,/soc/code@80000000,0,K)

config FLASH_BASE_ADDRESS
	default $(dt_node_reg_addr_hex,/soc/code@80000000)

endif # CODE_DDR

endif # SOC_SUMMIT_SOM8MPLUS
```

## soc/arm/lairdconnectivity/summit_som8m/Kconfig.series
```kconfig
# Summit SOM 8M series

# Copyright (c) 2022, Laird Connectivity
# SPDX-License-Identifier: Apache-2.0

config SOC_SERIES_SUMMIT_SOM8M
	bool "Summit SOM8M Series"
	select ARM
	select CPU_CORTEX_M7
	select SOC_FAMILY_SOM8M
	select CPU_HAS_FPU
	select CLOCK_CONTROL
	help
	  Enable support for Summit SOM8M series
```

## soc/arm/lairdconnectivity/summit_som8m/Kconfig.soc
```kconfig
# Summit SOM 8M series

# Copyright (c) 2022, Laird Connectivity
# SPDX-License-Identifier: Apache-2.0

choice
prompt "Summit SOM 8M Selection"
depends on SOC_SERIES_SUMMIT_SOM8M

config SOC_SUMMIT_SOM8MPLUS
	bool "SOC_SUMMIT_SOM8MPLUS"
	select HAS_MCUX
	select HAS_MCUX_CCM
	select HAS_MCUX_RDC
	select CPU_HAS_ARM_MPU
	select CPU_HAS_CUSTOM_FIXED_SOC_MPU_REGIONS
	select ARM_MPU
	select HAS_MCUX_IGPIO
	select HAS_MCUX_GPT
	select HAS_MCUX_AUDIOMIX
	select HAS_MCUX_GPC
	select HAS_MCUX_FLEXSPI
	select HAS_MCUX_ECSPI
	select HAS_MCUX_CACHE
	select HAS_MCUX_FLEXCAN

endchoice

if SOC_SERIES_SUMMIT_SOM8M

config SOC_PART_NUMBER_MIMX8ML8DVNLZ
	bool

config SOC_PART_NUMBER_IMX8ML_M7
	string
	default "MIMX8ML8DVNLZ" if SOC_PART_NUMBER_MIMX8ML8DVNLZ
	help
	  This string holds the full part number of the SoC. It is a hidden option
	  that you should not set directly. The part number selection choice defines
	  the default value for this string.

choice CODE_LOCATION
	prompt "Code location selection"

config CODE_ITCM
	bool "Link code into internal instruction tightly coupled memory (ITCM)"

config CODE_DDR
	bool "Link code into DDR memory"

endchoice

config INIT_VIDEO_PLL
	bool "Initialize Video PLL"
	default n

config SYSTEM_PLL1
	bool "Use System PLL 1"
	default n

config SYSTEM_PLL2
	bool "Use System PLL 2"
	default n

config SYSTEM_PLL3
	bool "Use System PLL 3"
	default n

config PM_MCUX_GPC
	bool "MCUX general power controller driver"

menu "M7 Clock"

choice
prompt "M7 Clock Root Selection"
default M7_CLOCK_ROOT_24M_OSC

config M7_CLOCK_ROOT_24M_OSC
	bool "Clock from OSC 24M"
config M7_CLOCK_ROOT_SYSTEM_PLL2_DIV5
	bool "Clock from SYSTEM PLL2 divided by 5"
	select SYSTEM_PLL2
config M7_CLOCK_ROOT_SYSTEM_PLL2_DIV4
	bool "Clock from SYSTEM PLL2 divided by 4"
	select SYSTEM_PLL2
config M7_CLOCK_ROOT_VPU_PLL
	bool "Clock from VPU PLL"
config M7_CLOCK_ROOT_SYSTEM_PLL1
	bool "Clock from SYSTEM PLL1"
	select SYSTEM_PLL1
config M7_CLOCK_ROOT_AUDIO_PLL1
	bool "Clock from AUDIO PLL1"
	select AUDIOMIX
config M7_CLOCK_ROOT_VIDEO_PLL1
	bool "Clock from VIDEO PLL1"
	select INIT_VIDEO_PLL
config M7_CLOCK_ROOT_SYSTEM_PLL3
	bool "Clock from SYSTEM PLL3"
	select SYSTEM_PLL3

endchoice

config M7_PRE_ROOT_DIVIDER
	int "M7 Pre-Root Divider"
	default 1

config M7_POST_ROOT_DIVIDER
	int "M7 Post-Root Divider"
	default 1

endmenu

menu "AHB Clock"

choice
prompt "AHB Clock Root Selection"
default AHB_CLOCK_ROOT_24M_OSC

config AHB_CLOCK_ROOT_24M_OSC
	bool "Clock from OSC 24M"
config AHB_CLOCK_ROOT_SYSTEM_PLL1_DIV6
	bool "Clock from SYSTEM PLL1 divided by 6"
	select SYSTEM_PLL1
config AHB_CLOCK_ROOT_SYSTEM_PLL1
	bool "Clock from SYSTEM PLL1"
	select SYSTEM_PLL1
config AHB_CLOCK_ROOT_SYSTEM_PLL1_DIV2
	bool "Clock from SYSTEM PLL1 divided by 2"
	select SYSTEM_PLL1
config AHB_CLOCK_ROOT_SYSTEM_PLL2_DIV8
	bool "Clock from SYSTEM PLL2 divided by 8"
	select SYSTEM_PLL2
config AHB_CLOCK_ROOT_SYSTEM_PLL3
	bool "Clock from SYSTEM PLL3"
	select SYSTEM_PLL3
config AHB_CLOCK_ROOT_AUDIO_PLL1
	bool "Clock from AUDIO PLL1"
	select AUDIOMIX
config AHB_CLOCK_ROOT_VIDEO_PLL1
	bool "Clock from VIDEO PLL1"
	select INIT_VIDEO_PLL

endchoice

config AHB_PRE_ROOT_DIVIDER
	int "AHB Pre-Root Divider"
	default 1

config AHB_POST_ROOT_DIVIDER
	int "AHB Post-Root Divider"
	default 1

endmenu

if AUDIOMIX

menu "Audio AHB Clock"

choice
prompt "Audio AHB Clock Root Selection"
default AUDIO_AHB_CLOCK_ROOT_SYSTEM_PLL1

config AUDIO_AHB_CLOCK_ROOT_24M_OSC
	bool "Clock from OSC 24M"
config AUDIO_AHB_CLOCK_ROOT_SYSTEM_PLL2_DIV2
	bool "Clock from SYSTEM PLL2 divided by 2"
	select SYSTEM_PLL2
config AUDIO_AHB_CLOCK_ROOT_SYSTEM_PLL1
	bool "Clock from SYSTEM PLL1"
	select SYSTEM_PLL1
config AUDIO_AHB_CLOCK_ROOT_SYSTEM_PLL2
	bool "Clock from SYSTEM PLL2"
	select SYSTEM_PLL2
config AUDIO_AHB_CLOCK_ROOT_SYSTEM_PLL2_DIV6
	bool "Clock from SYSTEM PLL2 divided by 6"
	select SYSTEM_PLL2
config AUDIO_AHB_CLOCK_ROOT_SYSTEM_PLL3
	bool "Clock from SYSTEM PLL3"
	select SYSTEM_PLL3
config AUDIO_AHB_CLOCK_ROOT_AUDIO_PLL1
	bool "Clock from AUDIO PLL1"
config AUDIO_AHB_CLOCK_ROOT_VIDEO_PLL1
	bool "Clock from VIDEO PLL1"
	select INIT_VIDEO_PLL

endchoice

config AUDIO_AHB_PRE_ROOT_DIVIDER
	int "Audio AHB Pre-Root Divider"
	default 1

config AUDIO_AHB_POST_ROOT_DIVIDER
	int "Audio AHB Post-Root Divider"
	default 2 if AUDIO_AHB_CLOCK_ROOT_SYSTEM_PLL1
	default 1

endmenu

endif # AUDIOMIX

endif # SOC_SERIES_SUMMIT_SOM8M
```

## soc/arm/nxp_imx/mimx8ml8_m7/Kconfig.defconfig.series
```kconfig
# i.MX8ML M7 SoC series defconfig

# Copyright (c) 2021, Laird Connectivity
# SPDX-License-Identifier: Apache-2.0

if SOC_SERIES_IMX8ML_M7

config SOC_SERIES
	default "mimx8ml8_m7"

config NUM_IRQS
	int
	# must be >= the highest interrupt number used
	default 159

if COUNTER

config COUNTER_MCUX_GPT
	default y if HAS_MCUX_GPT

endif # COUNTER

config CAN_MCUX_FLEXCAN
	default y if HAS_MCUX_FLEXCAN
	depends on CAN

config GPIO_MCUX_IGPIO
	default y if HAS_MCUX_IGPIO
	depends on GPIO

config PWM_IMX
	default y
	depends on PWM

config AUDIOMIX
	bool
	default y if HAS_MCUX_AUDIOMIX

config WDT_MCUX_IMX_WDOG
	default y
	depends on WATCHDOG

config PM_MCUX_GPC
	default y if HAS_MCUX_GPC
	depends on PM

config SPI_MCUX_ECSPI
	default y if HAS_MCUX_ECSPI
	depends on SPI

source "soc/arm/nxp_imx/mimx8ml8_m7/Kconfig.defconfig.mimx8ml8_m7"

endif # SOC_SERIES_IMX8ML_M7
```

## subsys/net/lib/lwm2m/Kconfig.gateway_obj
```kconfig
# Copyright (c) 2021 Laird Connectivity
# SPDX-License-Identifier: Apache-2.0

menuconfig LWM2M_GATEWAY_OBJ_SUPPORT
	bool "Enable LwM2M Gateway Object (25)"

if LWM2M_GATEWAY_OBJ_SUPPORT

config LWM2M_GATEWAY_MAX_INSTANCES
	int "Maximum number of bridged devices"
	default 1
	help
	  This setting establishes the total count of LwM2M Gateway
	  instances available to the LWM2M client.

choice
	prompt "Gateway object version"
	default LWM2M_GATEWAY_VERSION_3_0
	help
	  Select which version of the Gateway object should be used.

config LWM2M_GATEWAY_VERSION_2_0
	bool "IPSO Gateway object version 2.0"

config LWM2M_GATEWAY_VERSION_3_0
	bool "IPSO Gateway object version 3.0"
	help
	  Adds support for RSSI.

endchoice

config LWM2M_GATEWAY_DEFAULT_DEVICE_ID
	string "Identifies the IoT Device bridged to the LwM2M Gateway"
	default "Node"

config LWM2M_GATEWAY_DEVICE_ID_MAX_STR_SIZE
	int "Maximum string size for device ID"
	default 32

config LWM2M_GATEWAY_DEFAULT_DEVICE_PREFIX
	string "Used for access to LwM2M Objects of this IoT Device"
	default "n"

config LWM2M_GATEWAY_PREFIX_MAX_STR_SIZE
	int "Max string size for prefix"
	default 32

config LWM2M_GATEWAY_DEFAULT_IOT_DEVICE_OBJECTS
	string "Contains the Objects and Object Instances exposed by Gateway"
	default "</3>;ver=1.0,</3/0>,</4>;ver=1.0,</4/0>,</5>;ver=1.0,</5/0>,</9>;ver=1.0,</9/0>"
	help
	  It uses the same CoreLnk format as Registration Interface.

config LWM2M_GATEWAY_IOT_DEVICE_OBJECTS_MAX_STR_SIZE
	int "Maximum string size for IoT device objects"
	default 128

endif # LWM2M_GATEWAY_OBJ_SUPPORT
```

## subsys/net/lib/lwm2m/Kconfig.ipso
```kconfig
#
# Copyright (c) 2017 Linaro Limited
#
# SPDX-License-Identifier: Apache-2.0
#

menuconfig LWM2M_IPSO_SUPPORT
	bool "IPSO Alliance Smart Object Support"
	help
	  This option adds general support for IPSO objects

if LWM2M_IPSO_SUPPORT

config LWM2M_IPSO_TEMP_SENSOR
	bool "IPSO Temperature Sensor Support"
	help
	  This IPSO object should be used with a temperature sensor to
	  report a temperature measurement. It also provides resources for
	  minimum/maximum measured values and the minimum/maximum range
	  that can be measured by the temperature sensor.

config LWM2M_IPSO_TEMP_SENSOR_INSTANCE_COUNT
	int "Maximum # of IPSO Temperature Sensor object instances"
	default 1
	depends on LWM2M_IPSO_TEMP_SENSOR
	range 1 20
	help
	  This setting establishes the total count of IPSO Temperature
	  Sensor instances available to the LWM2M client.

config LWM2M_IPSO_LIGHT_CONTROL
	bool "IPSO Light Control Support"
	help
	  This Object is used to control a light source, such as a LED or other
	  light. It allows a light to be turned on or off and its dimmer
	  setting to be controlled as a % between 0 and 100. An optional color
	  setting enables a string to be used to indicate the desired color.

config LWM2M_IPSO_LIGHT_CONTROL_INSTANCE_COUNT
	int "Maximum # of IPSO Light Control object instances"
	default 1
	depends on LWM2M_IPSO_LIGHT_CONTROL
	range 1 20
	help
	  This setting establishes the total count of IPSO Light Control
	  instances available to the LWM2M client.

config LWM2M_IPSO_TIMER
	bool "IPSO Light Control Support"
	help
	  This Object is used to time events / actions

config LWM2M_IPSO_TIMER_INSTANCE_COUNT
	int "Maximum # of IPSO Timer object instances"
	default 1
	depends on LWM2M_IPSO_TIMER
	range 1 20
	help
	  This setting establishes the total count of IPSO Timer
	  instances available to the LWM2M client.

config LWM2M_IPSO_GENERIC_SENSOR
	bool "IPSO Generic Sensor Support"

config LWM2M_IPSO_GENERIC_SENSOR_INSTANCE_COUNT
	int "Maximum # of IPSO Generic Sensor object instances"
	default 1
	depends on LWM2M_IPSO_GENERIC_SENSOR
	range 1 20
	help
	  This setting establishes the total count of IPSO Generic
	  Sensors instances available to the LWM2M client.

config LWM2M_IPSO_GENERIC_SENSOR_IPSO_OBJECT_ID
	int "Maximum # of IPSO Generic Sensor object instances"
	default 3303
	depends on LWM2M_IPSO_GENERIC_SENSOR
	help
	  This is the object id of the sensor.
	  Examples:
	  3303 for temperature
	  3304 for humidity
	  3323 for pressure

config LWM2M_IPSO_GENERIC_SENSOR_NAME
	string "Name that will show up in debug output when object is created"
	default "Generic"
	depends on LWM2M_IPSO_GENERIC_SENSOR

config LWM2M_IPSO_HUMIDITY_SENSOR
	bool "IPSO Humidity Sensor Support"

config LWM2M_IPSO_HUMIDITY_SENSOR_INSTANCE_COUNT
	int "Maximum # of IPSO Humidity Sensor object instances"
	default 1
	depends on LWM2M_IPSO_HUMIDITY_SENSOR
	range 1 20

config LWM2M_IPSO_PRESSURE_SENSOR
	bool "IPSO Pressure Sensor Support"

config LWM2M_IPSO_PRESSURE_SENSOR_INSTANCE_COUNT
	int "Maximum # of IPSO Pressure Sensor object instances"
	default 1
	depends on LWM2M_IPSO_PRESSURE_SENSOR
	range 1 20

endif # LWM2M_LWM2M_IPSO_SUPPORT
```

## subsys/net/lib/lwm2m/Kconfig.ipso.current_sensor
```kconfig
# Copyright (c) 2021 Laird Connectivity
# SPDX-License-Identifier: Apache-2.0

menuconfig LWM2M_IPSO_CURRENT_SENSOR
	bool "IPSO Current Sensor Support"
	help
	  This IPSO object should be used with a current sensor to
	  report a current measurement. It also provides resources for
	  minimum/maximum measured values and the minimum/maximum range
	  that can be measured by the sensor.

if LWM2M_IPSO_CURRENT_SENSOR

config LWM2M_IPSO_CURRENT_SENSOR_INSTANCE_COUNT
	int "Maximum # of IPSO Current Sensor object instances"
	default 1
	help
	  This setting establishes the total count of IPSO Current
	  Sensor instances available to the LWM2M client.

choice
	prompt "IPSO Current object version"
	default LWM2M_IPSO_CURRENT_SENSOR_VERSION_1_0
	help
	  Select which version of the IPSO Current object should be used.

config LWM2M_IPSO_CURRENT_SENSOR_VERSION_1_0
	bool "IPSO Current object version 1.0"

config LWM2M_IPSO_CURRENT_SENSOR_VERSION_1_1
	bool "IPSO Current object version 1.1"
	help
	  Adds timestamp and measurement quality

endchoice

endif # LWM2M_IPSO_CURRENT_SENSOR
```

## subsys/net/lib/lwm2m/Kconfig.ipso.filling_sensor
```kconfig
# Copyright (c) 2021 Laird Connectivity
# SPDX-License-Identifier: Apache-2.0

menuconfig LWM2M_IPSO_FILLING_SENSOR
	bool "IPSO Filling sensor Support"
	help
	  This IPSO object can be used with an ultrasonic sensor to
	  report how full a container is.

if LWM2M_IPSO_FILLING_SENSOR

config LWM2M_IPSO_FILLING_SENSOR_INSTANCE_COUNT
	int "Maximum # of IPSO filling sensor object instances"
	default 1
	help
	  This setting establishes the total count of IPSO filling
	  sensor instances available to the LwM2M client.

endif # LWM2M_IPSO_FILLING_SENSOR
```
